## hw/alpha/Kconfig
```kconfig
config CLIPPER
    bool
    default y
    depends on ALPHA
    imply PCI_DEVICES
    imply TEST_DEVICES
    select M1543
    select TSUNAMI
    select AM29F016
    select DEC_PCI

config TSUNAMI
    bool
    default y
    depends on ALPHA
    select PCI
    select TIGBUS
    select BITBANG_I2C

config AM29F016
    bool
    select PFLASH_CFI02
    select TIGBUS

config TIGBUS
    bool

config LX164
    bool
    default y
    depends on ALPHA
    imply PCI_DEVICES
    imply TEST_DEVICES
    select PFLASH_CFI01
    select PYXIS
    select I82378
    select SMC37C669
    select IDE_CMD646
    select MC146818RTC
    select LSI_SCSI_PCI

config PYXIS
    bool
    default y
    depends on ALPHA
    select PCI
```

## hw/misc/macio/Kconfig
```kconfig
config CUDA
    bool

config MAC_PMU
    bool

config MAC_DBDMA
    bool

config MACIO_GPIO
    bool

config KEYWEST_I2C
    bool
    select I2C

config TAS3004
    bool
    select I2C

config MACIO_PULSAR
    bool
    select I2C
```
